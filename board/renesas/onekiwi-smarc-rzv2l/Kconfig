## board/renesas/onekiwi-smarc-rzv2l/Kconfig
```kconfig
if TARGET_ONEKIWI_SMARC_RZV2L

config SYS_SOC
	default "rmobile"

config SYS_BOARD
	default "onekiwi-smarc-rzv2l"

config SYS_VENDOR
	default "renesas"

config SYS_CONFIG_NAME
	default "onekiwi-smarc-rzv2l"

endif
```

## board/renesas/rzv2l-som-onekiwi/Kconfig
```kconfig
if TARGET_RZV2L_SOM_ONEKIWI

config SYS_SOC
	default "rmobile"

config SYS_BOARD
	default "rzv2l-som-onekiwi"

config SYS_VENDOR
	default "renesas"

config SYS_CONFIG_NAME
	default "rzv2l-som-onekiwi"

endif
```
