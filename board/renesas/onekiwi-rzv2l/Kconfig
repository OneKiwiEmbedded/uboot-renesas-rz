## board/renesas/onekiwi-rzv2l/Kconfig
```kconfig
if TARGET_ONEKIWI_RZV2L

config SYS_SOC
	default "rmobile"

config SYS_BOARD
	default "onekiwi-rzv2l"

config SYS_VENDOR
	default "renesas"

config SYS_CONFIG_NAME
	default "onekiwi-rzv2l"

endif
```
